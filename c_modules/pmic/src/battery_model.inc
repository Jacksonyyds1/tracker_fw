/*
 * Copyright (c) 2023 Nordic Semiconductor ASA
 * SPDX-License-Identifier: LicenseRef-Nordic-5-Clause
 */

.param_1 = {0.0, 0.005, 0.01, 0.015, 0.02, 0.025, 0.03, 0.035, 0.04, 0.045, 0.05, 0.055, 0.06, 0.065, 0.07, 0.075, 0.08, 0.085, 0.09, 0.095, 0.1, 0.105, 0.11, 0.115, 0.12, 0.125, 0.13, 0.135, 0.14, 0.145, 0.15, 0.155, 0.16, 0.165, 0.17, 0.17500000000000002, 0.18, 0.185, 0.19, 0.195, 0.2, 0.20500000000000002, 0.21, 0.215, 0.22, 0.225, 0.23, 0.23500000000000001, 0.24, 0.245, 0.25, 0.255, 0.26, 0.265, 0.27, 0.275, 0.28, 0.28500000000000003, 0.29, 0.295, 0.3, 0.305, 0.31, 0.315, 0.32, 0.325, 0.33, 0.335, 0.34, 0.34500000000000003, 0.35000000000000003, 0.355, 0.36, 0.365, 0.37, 0.375, 0.38, 0.385, 0.39, 0.395, 0.4, 0.405, 0.41000000000000003, 0.41500000000000004, 0.42, 0.425, 0.43, 0.435, 0.44, 0.445, 0.45, 0.455, 0.46, 0.465, 0.47000000000000003, 0.47500000000000003, 0.48, 0.485, 0.49, 0.495, 0.5, 0.505, 0.51, 0.515, 0.52, 0.525, 0.53, 0.535, 0.54, 0.545, 0.55, 0.555, 0.56, 0.5650000000000001, 0.5700000000000001, 0.5750000000000001, 0.58, 0.585, 0.59, 0.595, 0.6, 0.605, 0.61, 0.615, 0.62, 0.625, 0.63, 0.635, 0.64, 0.645, 0.65, 0.655, 0.66, 0.665, 0.67, 0.675, 0.68, 0.685, 0.6900000000000001, 0.6950000000000001, 0.7000000000000001, 0.705, 0.71, 0.715, 0.72, 0.725, 0.73, 0.735, 0.74, 0.745, 0.75, 0.755, 0.76, 0.765, 0.77, 0.775, 0.78, 0.785, 0.79, 0.795, 0.8, 0.805, 0.81, 0.8150000000000001, 0.8200000000000001, 0.8250000000000001, 0.8300000000000001, 0.835, 0.84, 0.845, 0.85, 0.855, 0.86, 0.865, 0.87, 0.875, 0.88, 0.885, 0.89, 0.895, 0.9, 0.905, 0.91, 0.915, 0.92, 0.925, 0.93, 0.935, 0.9400000000000001, 0.9450000000000001, 0.9500000000000001, 0.9550000000000001, 0.96, 0.965, 0.97, 0.975, 0.98, 0.985, 0.99, 0.995, 1.0},
.temps = {14.0, 25.0, 54.0},
.param_2 = {2.99, 3.001652892561984, 3.013305785123967, 3.0249586776859507, 3.036611570247934, 3.0482644628099176, 3.0599173553719012, 3.0715702479338844, 3.083223140495868, 3.0948760330578513, 3.106528925619835, 3.118181818181818, 3.129834710743802, 3.1414876033057855, 3.1531404958677687, 3.1647933884297523, 3.176446280991736, 3.188099173553719, 3.199752066115703, 3.211404958677686, 3.2230578512396697, 3.234710743801653, 3.2463636363636366, 3.25801652892562, 3.2696694214876034, 3.281322314049587, 3.2929752066115707, 3.304628099173554, 3.3162809917355376, 3.327933884297521, 3.3395867768595044, 3.3512396694214877, 3.3628925619834713, 3.374545454545455, 3.386198347107438, 3.397851239669422, 3.409504132231405, 3.4211570247933887, 3.432809917355372, 3.4444628099173555, 3.456115702479339, 3.4677685950413224, 3.479421487603306, 3.4910743801652897, 3.502727272727273, 3.5143801652892566, 3.5260330578512398, 3.5376859504132234, 3.5493388429752066, 3.5609917355371903, 3.572644628099174, 3.584297520661157, 3.595950413223141, 3.6076033057851244, 3.6192561983471077, 3.6309090909090913, 3.6425619834710745, 3.654214876033058, 3.6658677685950414, 3.677520661157025, 3.6891735537190087, 3.700826446280992, 3.7124793388429755, 3.724132231404959, 3.7357851239669424, 3.7474380165289256, 3.7590909090909093, 3.770743801652893, 3.782396694214876, 3.7940495867768598, 3.8057024793388434, 3.8173553719008266, 3.8290082644628103, 3.8406611570247935, 3.852314049586777, 3.8639669421487604, 3.875619834710744, 3.8872727272727277, 3.898925619834711, 3.9105785123966945, 3.922231404958678, 3.9338842975206614, 3.945537190082645, 3.9571900826446282, 3.968842975206612, 3.980495867768595, 3.9921487603305787, 4.003801652892562, 4.015454545454546, 4.027107438016529, 4.038760330578513, 4.050413223140496, 4.062066115702479, 4.073719008264463, 4.085371900826447, 4.09702479338843, 4.108677685950413, 4.120330578512397, 4.13198347107438, 4.1436363636363645, 4.155289256198348, 4.166942148760331, 4.178595041322314, 4.190247933884297, 4.201900826446281, 4.213553719008265, 4.225206611570249, 4.236859504132232, 4.248512396694215, 4.260165289256198, 4.271818181818182, 4.283471074380166, 4.295123966942149, 4.306776859504133, 4.318429752066116, 4.330082644628099, 4.3417355371900825, 4.353388429752067, 4.36504132231405, 4.376694214876033, 4.388347107438017, 4.4},
.param_3 = {-0.002896350367962902, -0.0027278092224042906, -0.002562874646670347, -0.002409866799260491, -0.0022771058386743584, -0.0021730370253925497, -0.002100648786161817, -0.002029587473660076, -0.001938215654676721, -0.001827868609338494, -0.0016970283136879115, -0.001539167092989281, -0.0013410085267833414, -0.0011090600604598615, -0.0008721274882215506, -0.0006600221355677222, -0.0004988938436359298, -0.00040444101541274455, -0.00037028264714352187, -0.00037461679771213385, -0.0003864785529164398, -0.00038598043242466255, -0.0003767513538088057, -0.000368975806056213, -0.0003758576997577696, -0.00040076308458023756, -0.00044327621565498745, -0.0004968651948339535, -0.0005528576536088976, -0.0006018989600544592, -0.000630419227332844, -0.0006311299221029186, -0.0006066705891993892, -0.0005669473034082768, -0.0005305185129623214, -0.0005071572777568423, -0.0005030077167047201, -0.0005112588144185893, -0.0005218785484762168, -0.0005254604381644311, -0.0005180169755148557, -0.0005023042769993123, -0.0004823864682666418, -0.00046233688468026306, -0.0004457579097030068, -0.00043560427664638145, -0.00043448573356831896, -0.000441860857540866, -0.00045340882310307407, -0.000464337625120571, -0.00047057332173897943, -0.0004705556161800316, -0.0004636340521817066, -0.0004495619986092779, -0.0004320920913299978, -0.0004177392124161299, -0.00041285035470792577, -0.0004171499197248376, -0.0004211022026338507, -0.0004143563797629052, -0.00038972453625287553, -0.0003493614603833708, -0.0002973574818996285, -0.00023789968709772054, -0.000175235602727688, -0.00011339679869775523, -5.6342012886982744e-05, -7.663067756885978e-06, 2.880009572858263e-05, 4.915983726109547e-05, 5.3485797510245635e-05, 5.1792244921811024e-05, 5.563049556405451e-05, 7.360480860055428e-05, 9.885537131425932e-05, 0.00011956410968076006, 0.00012485346521940916, 0.00011716960512645753, 0.00010866819907787201, 0.00011156670466589441, 0.00012962496764451533, 0.0001532967482853382, 0.00017184606334899756, 0.00017732876054275633, 0.00017331760243542046, 0.00016682971493357443, 0.00016462027751743463, 0.00016904628563556534, 0.00017774569220213666, 0.00018802651113277482, 0.00019800916142493193, 0.00020960373280159143, 0.00022574072298932782, 0.00024788524359520986, 0.0002721296328713739, 0.0002922030347643834, 0.00030240856213614427, 0.00030169009720450683, 0.0002929350548659392, 0.00027966086862563414, 0.00026851252299940447, 0.00026595105500518937, 0.00027739053284412594, 0.0002999519511653706, 0.00031961569056355733, 0.0003222383426154824, 0.00030105775999758307, 0.00027161863953309044, 0.00025364321201077494, 0.0002634571012776861, 0.0002924106229141891, 0.00032074845115885126, 0.0003295665069423396, 0.00031734638902624767, 0.000297429301228864, 0.0002822920171411801, 0.00027890712999590483, 0.00028420674654786314, 0.00029630290212619967, 0.0003133055378466057, 0.0003311633981086511, 0.00034526707441288396, 0.0003510900568920406, 0.00034640908735374245, 0.00033172456416596843, 0.0003096420340973925, 0.00028587369128430033, 0.00026851312332722675, 0.0002603172576704467, 0.0002608367070702619, 0.0002649353403336209, 0.0002683628706754922, 0.00026874223654217586, 0.00026734152491405963, 0.0002672412686995564, 0.0002719888213593142, 0.0002823934840045313, 0.000296877468007399, 0.0003137161078828148, 0.00033085499125150053, 0.00034568487474170373, 0.00035512888252785843, 0.0003576826693153682, 0.000359420748369718, 0.00036796916551509317, 0.0003889265677618775, 0.00041710726198851357, 0.00044190194341042966, 0.00045528008113326473, 0.00045586547460761386, 0.00044871846008906767, 0.0004378878591626406, 0.00042572558046779125, 0.00041447886406237793, 0.00040656208896223327, 0.00040448764571463045, 0.0004077577481748088, 0.0004148278559221469, 0.0004241528057222595, 0.0004341874343407901, 0.00044339141673641774, 0.00045035053906449207, 0.00045453436065746335, 0.0004566489616548576, 0.0004575079730829042, 0.0004579250259676144, 0.00045871375133534813, 0.00046067170365606533, 0.00046430020251514176, 0.00046898166737389176, 0.00047363071307031834, 0.000477159693725561, 0.00047848096346061363, 0.0004765068763967174, 0.000470218245618077, 0.00045957165899644724, 0.00044604735648714165, 0.00043130832850360695, 0.0004170175654594495, 0.00040483805776799983, 0.00039643217004816376, 0.00039313524949887167, 0.00039427847537335556, 0.00039817122455165814, 0.0004031092553189757, 0.0004073883259600835, 0.0004093041947601196, 0.0004071514057713361, 0.00039976464313789254, 0.00038762612749429807, 0.00037152033150207744, 0.00035223172782281346, 0.00033054478911808874, 0.000307243988049399, 0.00028311379727838495, 0.0002589386894665133, 0.0002355031372754829, 0.00021359161336671672, 0.00019398859040182666, 0.0001774785410424099, 0.00016484593794994755},
.param_4 = {3.3332359081224956, 3.401487987703615, 3.457229862658227, 3.502458523244893, 3.53917095972218, 3.5693712656099557, 3.5953008438020624, 3.6187645745507715, 3.640271263988568, 3.6594785872970874, 3.6758285070104333, 3.6886267085720177, 3.697075973403694, 3.7013399870054178, 3.7026274587765005, 3.7021958190111923, 3.7011680840639913, 3.7003755738152817, 3.700244715815634, 3.70088131097939, 3.7018443416725226, 3.702657274780736, 3.703280438740972, 3.703914957626969, 3.7049619731441026, 3.706647191818695, 3.7090963526372605, 3.712267417826635, 3.7160868440832497, 3.7204537169936485, 3.7249047044699375, 3.728837247088287, 3.7318261915268343, 3.733842089637743, 3.735572474444599, 3.7376141390034747, 3.74041837032676, 3.7437567246355754, 3.747185648607394, 3.750280572798152, 3.7528724602461723, 3.7550624244545605, 3.756981506940562, 3.7587619060863875, 3.760530522885287, 3.7624029363293667, 3.7644819912349528, 3.766775740770558, 3.7692110076612284, 3.771706117242889, 3.774178976544457, 3.7765646099918087, 3.778811757757223, 3.7808919346660157, 3.7829177293669494, 3.785071244023328, 3.7875233363011627, 3.790222588342602, 3.792878519261405, 3.7951847870124387, 3.796940559074619, 3.798199274159736, 3.79905843617676, 3.7996298710290435, 3.800094881405316, 3.800653957371417, 3.8014989891771465, 3.8026734622706555, 3.8040958087813905, 3.8056807576496463, 3.807355416460922, 3.8090718477834864, 3.8107849613622045, 3.812479728691369, 3.8142391013544814, 3.816150685261399, 3.8182866048637876, 3.8205488483928693, 3.8227500105667156, 3.8247067390613907, 3.826399170468193, 3.8280771686007746, 3.8300176395898045, 3.8324302126321808, 3.8351576650401777, 3.8378911448958983, 3.8403280714957977, 3.842389041205603, 3.844299220581321, 3.846308326759139, 3.8485957362991337, 3.851036600032418, 3.853425268069895, 3.855594272704317, 3.857638847170123, 3.8598229556244683, 3.86240225942821, 3.8654541827094313, 3.868805540111698, 3.872251216415583, 3.8755538987879095, 3.8786304393374107, 3.8814713204068916, 3.884219059444593, 3.8871725312271908, 3.8905848836926267, 3.8945699472448307, 3.8988263581720157, 3.9029747795857137, 3.906698993492636, 3.91014744893991, 3.9136720151655506, 3.9176071615629224, 3.921965527661817, 3.9265508990694395, 3.9312669424439157, 3.936124999597807, 3.9412786792119983, 3.9467125995064287, 3.952381250614393, 3.958281714658536, 3.964457908366559, 3.970978642125789, 3.9778690038197917, 3.985025390422398, 3.992185190665793, 3.9990177532843254, 4.005211171766466, 4.010827301413462, 4.016062584293171, 4.021193675361907, 4.026377920984614, 4.031660152489105, 4.037015239598647, 4.042377930803408, 4.047668069523603, 4.05285655346715, 4.057959429932096, 4.062999495148083, 4.068007125122839, 4.073023453703556, 4.078103005141837, 4.083273272739042, 4.088420586971385, 4.093422714421968, 4.0982475547509045, 4.103072166150412, 4.108158765961145, 4.113600208682739, 4.1193090078054695, 4.125079863035865, 4.130808721138321, 4.136524642270517, 4.1422648925611565, 4.148045945734122, 4.153817129042519, 4.159568878228028, 4.165311122934423, 4.171053804404251, 4.176806863880071, 4.182580224969327, 4.188390040416, 4.194251216971321, 4.200157128343906, 4.206099145301952, 4.212068638613666, 4.218056979047239, 4.224055402330858, 4.23005156057216, 4.236045695733155, 4.242046483650282, 4.248062642261747, 4.254102889505755, 4.2601759433205055, 4.266289539197865, 4.272436612569326, 4.278583406278019, 4.284692764189358, 4.290727530168752, 4.296650548081619, 4.302424687200857, 4.308022140443195, 4.313459666826746, 4.318774026787085, 4.32400223438145, 4.329181303667084, 4.334348248701222, 4.339540204982533, 4.3447871639758375, 4.3500917590125985, 4.355451175637007, 4.360862599393257, 4.36632321582553, 4.371830210478031, 4.37738076889494, 4.382972076620454, 4.388601319198759, 4.394265682174051, 4.399962351090521, 4.405688511492355, 4.411441348923749},
.param_5 = {13.650415916223846, 12.399395453573137, 10.097053554127822, 8.194109706395292, 6.691274236506262, 5.612988407988251, 4.939330894081584, 4.497042018650577, 4.071401274631592, 3.5557243021865137, 2.914812127493027, 2.1247466393260694, 1.2713278433400088, 0.5551485372806475, 0.08558320057745483, -0.14593747125091205, -0.18202451959106192, -0.09233682483573702, 0.050573716410839964, 0.15996258568886645, 0.17759638013457035, 0.14360970684492713, 0.12576828462331768, 0.168153440313068, 0.27322341917259685, 0.4134379493157869, 0.5620226007939877, 0.6990491445989289, 0.8186299167013633, 0.8817860386687748, 0.8383530094638658, 0.6921487056896769, 0.500484254945599, 0.3746282917764798, 0.3772049365731611, 0.4845895882160889, 0.6142585632100683, 0.6767278280634059, 0.6523848162576673, 0.5686811638778266, 0.4781851656408431, 0.41090466943898285, 0.3699481631826984, 0.354901594472512, 0.36410302429792374, 0.39514683496655323, 0.437280444119148, 0.4729016426275656, 0.4930376472330966, 0.49679688832284796, 0.4858492748919474, 0.4632781212766002, 0.4327324674207045, 0.41059716097264776, 0.41793093573123663, 0.4605606934213302, 0.5151344319274109, 0.5355182960242288, 0.4962198669836493, 0.4062039813213847, 0.3014487147297462, 0.21178771021412857, 0.14305968693073545, 0.10364452285558379, 0.1024086342373387, 0.14041077718305317, 0.20195048992386333, 0.25968196042440717, 0.3007295378990804, 0.32596076795314843, 0.3391090133840091, 0.3429544901282444, 0.3407880907882799, 0.345413999227695, 0.3670956570029915, 0.40475035093061607, 0.4398163131470234, 0.4463405702928025, 0.4157890668521347, 0.36491599014771836, 0.33704295393839345, 0.3618469121611678, 0.4353044031406128, 0.5140025450373287, 0.5460932263717577, 0.5170406455619947, 0.4497896309704874, 0.3971149085523429, 0.3919285553535712, 0.42965157178125324, 0.4728273273279182, 0.4829531770761175, 0.45576726718987715, 0.42135791002282375, 0.42286829201514387, 0.4763412258086852, 0.5631227084962998, 0.6403280683488166, 0.6797033706151812, 0.6748358676211375, 0.6379222921827576, 0.5917421618982122, 0.5588620107182418, 0.5701210820299174, 0.6365824248033558, 0.7397416017639991, 0.8241474479389055, 0.8404832340882962, 0.7872635320620436, 0.7172669354196248, 0.697302167291447, 0.7459712623012482, 0.829351249626642, 0.8943737506517113, 0.9301414782098671, 0.9574100528367602, 1.0011736768082535, 1.058759990862157, 1.11025714023949, 1.1569115152107123, 1.2076657752166042, 1.269692746725326, 1.341109545323249, 1.404674829660868, 1.4316186846001333, 1.399236286192762, 1.302598110067299, 1.1809548129136704, 1.0851412526704962, 1.0366373948444974, 1.0315336691443022, 1.0466477127198281, 1.0637318614032942, 1.0717778314302429, 1.0652829924955753, 1.0478622663741888, 1.0291360408492878, 1.0142941680933326, 1.0047695190743333, 1.0023958555472667, 1.009588001899786, 1.0249819035486496, 1.0317581829548672, 1.0149441682925975, 0.982696777951908, 0.9649451728443559, 0.991121121024019, 1.0528042532326864, 1.1150241844324782, 1.1479654353126811, 1.1499713332851158, 1.1444779234651925, 1.1456171422835837, 1.1521303463604582, 1.15522364813625, 1.1522932493906346, 1.1493993891903642, 1.1484926176223098, 1.149574094564798, 1.1526420565076023, 1.1583176535929773, 1.1670992001993952, 1.1767087927905706, 1.184792833063053, 1.1911510269760228, 1.1957833745286806, 1.1986763717191984, 1.1994581524921166, 1.199029340229707, 1.1994923078122, 1.2016946528591532, 1.2056405855473074, 1.211330105875863, 1.2186649692109697, 1.22606692488203, 1.2293867080154008, 1.2256151620031908, 1.2144123890733383, 1.1957783892261098, 1.1697157032105387, 1.1371592361576255, 1.1034979625888397, 1.0751886343889794, 1.0542567554704618, 1.0407276879998761, 1.0346014319771335, 1.0358901315449032, 1.0438915274615823, 1.0551554030065802, 1.0664011661169148, 1.0770840380658342, 1.0872040188523613, 1.0967611084773843, 1.105755306940992, 1.1141866142422963, 1.1220550303819188, 1.1293605553597708, 1.1361031891761186, 1.1422829318303407, 1.147899783322881, 1.1505674862789306},
.param_6 = {0.033708229111722304, 0.033347572129255494, 0.03179424231437994, 0.028576880799598872, 0.023682977386794153, 0.017645705251254126, 0.014344955173247386, 0.016243313148509627, 0.020171886432158177, 0.024118734098880934, 0.02887015163492131, 0.03560197869045701, 0.043010703252941936, 0.04688810385617908, 0.04490379248921393, 0.03732336445856208, 0.025558112015497764, 0.012861119649240796, 0.0029824217700610703, -0.0016195905772917922, -0.0011363634712528703, 0.0009727199107634091, 0.0017004626368449555, 8.936540510361157e-05, -0.003178727852402456, -0.006741851589721787, -0.009610211025371598, -0.010958143795391014, -0.01050337652205057, -0.007756157372394636, -0.002923096204845933, 0.00237486381334548, 0.006418261869464172, 0.007615207623706778, 0.0059790025651434535, 0.0027510796257601317, -0.0004101536661747004, -0.0018870831771496772, -0.0014201623745841796, 0.0003861572961361159, 0.0023156161165118773, 0.00356305072482139, 0.0039967392319049284, 0.003662855856363499, 0.0026732608033881613, 0.0011272176134687832, -0.0006256580894484535, -0.0018923089534755107, -0.0022476767579705046, -0.0017164498635905366, -0.0006217991059460557, 0.0006939269557272847, 0.002099361757075367, 0.00315419608517088, 0.0031822786193148, 0.0019241736622072016, 5.892926912923224e-05, -0.0008251847925924921, 0.00027935399619323834, 0.003137766638097516, 0.0064994919379534385, 0.009236705435324705, 0.011146177328565028, 0.012212187917194047, 0.012450288839996531, 0.011889358984070526, 0.010573373094086925, 0.008514210861556537, 0.005682290501798144, 0.0024685701781663005, 0.00026324076607155524, 0.00021446980538088734, 0.0021812563678743255, 0.004322487575020481, 0.004595930108020578, 0.0025998093905149843, -0.00023945045543025307, -0.0016185266141537148, -0.0005602900460563119, 0.002095676856664332, 0.00417300436194438, 0.004222109570448223, 0.0024032012257418117, 0.00014715390864228947, -0.0010499045609181899, -0.0008697324917985829, 0.00022165707019909078, 0.0013125414684702031, 0.0018980225497209485, 0.0020263469222795267, 0.0021577221668816603, 0.0027731561564395893, 0.0038281510793618427, 0.0046388909882046055, 0.004431779116917356, 0.0030278929264770395, 0.000948706244012341, -0.0009473507270205085, -0.0022029228578872694, -0.002442253186653472, -0.0013709813620444767, 0.0008878009844721479, 0.003400089616018123, 0.004222515771943138, 0.0022286391450111794, -0.0018557930565974259, -0.005061970308239195, -0.0047414547986808124, -0.0008161538255404351, 0.0038767410903414144, 0.005729134988116516, 0.003715588402815052, -0.00034020621326035926, -0.003213720571347561, -0.003505437188506757, -0.0018522171232959164, 0.00019147294066830522, 0.0017395772130294833, 0.002909879129874254, 0.0034860495982451454, 0.003196153656627828, 0.0019926658783389465, 0.00011420129408584918, -0.0019365492726072157, -0.0036767053256349953, -0.00458508728816681, -0.004112891077016575, -0.002555643361385363, -0.000767641625696485, 0.0004618082663174173, 0.0007526163605230324, 0.00038068962085549833, -0.000102134576143259, -0.00015009678426194527, 0.0004647296445254559, 0.0015152215304974905, 0.0024888646648084834, 0.003132262387828348, 0.0033977523244101506, 0.0031968766858888947, 0.0024273891276357894, 0.0011997794573664487, 0.0004291865841859598, 0.0010286496199724948, 0.0029505819392159466, 0.00491380964734204, 0.005297537564855216, 0.003817281914475116, 0.0013963531197184196, -0.000656162104419706, -0.0017977615444973272, -0.0022992879621276424, -0.002340899510026265, -0.001916349150555798, -0.0009991218347747482, 0.00011956592125755361, 0.0010340210207516445, 0.0016395057547450686, 0.0019359578418643212, 0.001923861101415825, 0.001616310472370196, 0.001114294392104561, 0.0006298422590365546, 0.00029736124254408454, 0.00012760643127567592, 0.0001205778252443934, 0.000274667768845096, 0.0005586451179793637, 0.0008309963717826425, 0.000933051055517658, 0.0008178026351669235, 0.00048502503902952856, -6.528173288435687e-05, -0.0008262717842536643, -0.001693521740027019, -0.0024170889130935335, -0.0028263330492840286, -0.002902979102769216, -0.002647027073560712, -0.002058539541128574, -0.0011702808269128159, -0.0002153694674808201, 0.0005035975052786472, 0.0008830779945620169, 0.0009217101408425334, 0.0006194939441143857, -2.3692018874738648e-05, -0.0009539551622227041, -0.0019525278277038023, -0.0028244311635815104, -0.003539439967148461, -0.004097554238398869, -0.0044987739773414475, -0.0047430991839703795, -0.004830529858288569, -0.004761066000290206, -0.004534707609979658, -0.004151454687365623, -0.003611307232430681, -0.0029142652451879104, -0.002526520618492472},
.param_7 = {0.0, 0.0, 0.0, 0.0, 0.0, 0.0, 0.0, 0.0, 0.0, 0.0, 0.0, 0.0, 0.0, 0.0, 0.0, 0.0, 0.0, 0.0, 1.297218347541363e-05, 3.117477841159306e-05, 4.8081112923235984e-05, 6.498744743487827e-05, 8.18937819465212e-05, 9.880011645816409e-05, 0.00011698511091359856, 0.0001375824560254448, 0.0001580291598354999, 0.00017728163556486587, 0.00019653411129423262, 0.00021581487401750517, 0.00023137104856033047, 0.00023566739953905823, 0.0002395782866616982, 0.00024212685810995005, 0.00024786324593930963, 0.00025562129355493935, 0.00026166555926443273, 0.0002663507548039136, 0.00027703408685236553, 0.00028948702170120713, 0.00029838526693057413, 0.0003131725364168359, 0.00033023849431940616, 0.0003482645868155296, 0.0003642836576118418, 0.0003803883756637174, 0.00039727500288482394, 0.00040619476277709726, 0.00041683366831859466, 0.000423029830870642, 0.00042612620816987785, 0.0004277150224667714, 0.00043024089719647475, 0.000432364869646913, 0.0004416538156117019, 0.0004518585904164755, 0.00046785606414953047, 0.0004917859687030066, 0.0005313032190562164, 0.0006638076780394252, 0.0020564924809591007, 0.0008403288453205844, 0.000837332800736087, 0.0009156525867457327, 0.0008816462220274608, 0.0010928436052848342, 0.0009159564302110252, 0.0008604064545632709, 0.0007166233509861006, 0.000384760849597831, -7.448277800081546e-05, -0.000174538407655236, -0.00026445042131261127, -0.0003408567848437799, -0.00036621377545440707, -0.00041748958813877564, -0.00048306006891925225, -0.00045843381694877394, -0.0004192805434900662, -0.0004138999347682416, -0.0003289145598518684, -0.0003824442195244966, -0.00029631412227173185, -0.0002461083328490041, -0.0002460443989915493, -0.00025417342179889394, -0.0002581692351791402, -0.0002569105683143262, -0.00025335838295998205, -0.0002468872433654446, -0.0002517161319422628, -0.000250773743960673, -0.0002513362866451148, -0.0002721498950982715, -0.0003060381547242966, -0.0003384258255322861, -0.0003428366376510712, -0.0003515414231098156, -0.00038580120483180984, -0.0004079613441729272, -0.00039184613161359074, -0.0003605730331122612, -0.0003467825540952301, -0.0003532243475536857, -0.0003663351719612229, -0.0003764375393527026, -0.0003783638659360701, -0.0003763773465959917, -0.0003775608960045013, -0.00038468288454230964, -0.00039501923883520376, -0.00040157119083656355, -0.000398255324696854, -0.0003827377759788764, -0.0003660475297498921, -0.00036284667917369927, -0.0003772746143136847, -0.0003968270950745939, -0.00040116916137446207, -0.00037183216880136617, -0.0003117321286749472, -0.00024208458168189375},
.param_8 = {0.0, 0.0, 0.0, 0.0, 0.0, 0.0, 0.0, 0.0, 0.0, 0.0, 0.0, 0.0, 0.0, 0.0, 0.0, 0.0, 0.0, 0.0, -0.00024158341689719577, -0.00038187575206566707, -0.00042048365837600316, -0.0004590915646863373, -0.0004976994709966731, -0.000536307377307008, -0.0005987280086575309, -0.0007060743007832462, -0.0008016036196795693, -0.0008034523802463364, -0.0008053011408131037, -0.0008076766953968266, -0.000494949198430108, 0.0003553796785086812, 0.0012359460534917303, 0.0022233785247101202, 0.003151443690860016, 0.0040718723836490785, 0.0050741257615644, 0.006182990643927436, 0.0072211923025814855, 0.008226438314880489, 0.009405023680000022, 0.010584054874523513, 0.011720649625352032, 0.012860784604118861, 0.0142348859487263, 0.015607392268356998, 0.016985153827281815, 0.018768663733023237, 0.020534229984032162, 0.022554642552064637, 0.024833360342369562, 0.027241847202642323, 0.029793353199114827, 0.03243665735675513, 0.035053234239714244, 0.03783855145376968, 0.04063493191387297, 0.043727945188994755, 0.04703285389529103, 0.04965667703358716, 0.03314187186070489, 0.11650504853997104, 0.1335148064549428, 0.14931593979979227, 0.17145928262331178, 0.18764812299300493, 0.2197916155022446, 0.2452047948326888, 0.2710777659941251, 0.3041014704594267, 0.34411764771046915, 0.37590891961788875, 0.4057877562236227, 0.4306233472677084, 0.45656942878776785, 0.4804257442619984, 0.5010408932110337, 0.5196723534283316, 0.5360507396666756, 0.5514005039977166, 0.5645055243320466, 0.5795204172407873, 0.5894550518919646, 0.5986104726441361, 0.6079237710755068, 0.6168004641187581, 0.6253819736565294, 0.6343988404230589, 0.644700165104619, 0.6555798246448024, 0.666661739703446, 0.6775864037493292, 0.6884546662684916, 0.6996989185703656, 0.7113174131884188, 0.7231819372300532, 0.7343131835382873, 0.7449535397661073, 0.7560442546305961, 0.7670504736484736, 0.7769511083317575, 0.7863658256800606, 0.7960492913337446, 0.8061276630794127, 0.8163138056363038, 0.8263260475503973, 0.8359831743528301, 0.8454263620925953, 0.8549662074620116, 0.8647207644586632, 0.8746812361938364, 0.8846947121794616, 0.8946473954726476, 0.9045211858751742, 0.9146091405692017, 0.9252891681580536, 0.9366456702021301, 0.9483940008282906, 0.9600288152990702, 0.9710637339198657, 0.9814119752614041, 0.9913626708125308},
.param_9 = {0.5999059893314862, 0.4333763524369214, 0.315162978631222},
.param_10 = {101.82532280701825, 50.602706499252555, 44.135348575245764, 0.7888025947984537, 0.6334039166534796, 0.25869915149859823},
.param_11 = {0.240874213642026, 0.16485790924629062, 0.08226662593694273, 0.003780025329650221, 0.0031751171113437527, 0.0014818990259244686},
.param_12 = {0.5162082555560715, 0.5167288111339589, 0.5300503888895565},
.name = {'G', 'R', 'E', 'P', 'O', 'W', '5', '2', '0', 'D', '1', 'A'},