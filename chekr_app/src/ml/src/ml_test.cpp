#include <zephyr/shell/shell.h>
#include <zephyr/fs/fs.h>
#include <zephyr/logging/log_ctrl.h>
#include <zephyr/logging/log.h>
#include <vector>

#include "baseLib.hpp"
#include "ml.h"
#include "storage.h"
#include "utils.h"

// test vectors from PTC 'DogCollar_EdgePackage 3.1.0' app
std::vector<float> trot_sample15_16_17 = {
	-0.296703994, -1.467903972, -0.632448018, -51.52000046, 34.72000122,  -175.8399963,
	0.679296017,  -1.06188798,  -0.015616,    -154.5599976, -115.3600006, 230.7200012,
	-2.857728004, 0.741760015,  -2.717184067, -81.76000214, 59.36000061,  193.7599945,
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	-1.405439973, 0.49971199,   -0.085887998, 106.4000015,  -60.47999954, 109.7600021};
std::vector<float> walk_sample27_28_29 = {
	-0.51532799,  -0.452863991, -0.452863991, -122.0800018, -61.59999847, 14.56000042,
	-1.02284801,  -0.632448018, -0.343551993, -176.9600067, -12.31999969, -24.63999939,
	-1.100927949, -0.593407989, -0.296703994, -171.3600006, 14.56000042,  3.359999895,
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	-0.538752019, -0.648064017, -0.52313602,  -43.68000031, 11.19999981,  3.359999895};

LOG_MODULE_REGISTER(ml_test, LOG_LEVEL_DBG);

static void feed_vectors(std::vector<float> *ptr_vector)
{
	size_t readings = ptr_vector->size() / NUM_FLOATS_PER_IMU_SAMPLE;
	int sample_count = 0;

	for (size_t i = 0; i < readings; i++) {
		imu_sample_t sample = {0};
		sample.timestamp = utils_get_currentmillis();
		sample.sample_count = sample_count;
		sample.ax = (*ptr_vector)[(i * NUM_FLOATS_PER_IMU_SAMPLE) + 0];
		sample.ay = (*ptr_vector)[(i * NUM_FLOATS_PER_IMU_SAMPLE) + 1];
		sample.az = (*ptr_vector)[(i * NUM_FLOATS_PER_IMU_SAMPLE) + 2];
		sample.gx = (*ptr_vector)[(i * NUM_FLOATS_PER_IMU_SAMPLE) + 3];
		sample.gy = (*ptr_vector)[(i * NUM_FLOATS_PER_IMU_SAMPLE) + 4];
		sample.gz = (*ptr_vector)[(i * NUM_FLOATS_PER_IMU_SAMPLE) + 5];

		ml_feed_sample(sample);

		LOG_DBG("fed line %d at %llu\r\n", i, sample.timestamp);
		LOG_PANIC(); // flush

		// 14.925 Hz
		k_msleep(67);

		// we're already 'downsampling' at 15Hz
		sample_count += ML_15HZ_DOWNSAMPLE_RATE;
	}
}

// feed the ML test vectors thru our ML API's and verify the output
static int ml_test_shell(const struct shell *sh, size_t argc, char **argv)
{
	shell_fprintf(sh, SHELL_NORMAL, "testing ML integration\r\n");

	// this is what sample sets dog size to
	ml_set_dog_size(PET_SIZE_SMALL);

	const char *filename = "ml_test";
	file_handle_t handle = storage_open_file((char *)filename);

	if (handle == NULL) {
		LOG_ERR("failed to open file %s", filename);
		return -1;
	}

	// start the ML sampling
	int ret = ml_start(true, handle);
	if (ret) {
		LOG_ERR("failed to start ML");
		storage_close_file(handle);
		return -1;
	}

	LOG_DBG("feeding trot test data:");
	feed_vectors(&trot_sample15_16_17);

	LOG_DBG("feeding walk test data:");
	feed_vectors(&walk_sample27_28_29);

	// stop the ML sampling
	ret = ml_start(false, handle);
	if (ret) {
		LOG_ERR("failed to stop ML");
		storage_close_file(handle);
		return -1;
	}

	ret = storage_close_file(handle);
	if (ret) {
		LOG_ERR("failed to close file %s", filename);
		return -1;
	}
	LOG_INF("Closed file: %s...", filename);

	activity_record_t record = {0};

	// the 1st record should be a 'trot' activity
	storage_read_activity_record((char *)filename, 0, &record);
	if ((record.activity_data.model_type != Activity) ||
	    (record.activity_data.activity_type != trot)) {
		LOG_ERR("wrong inference data: expected 'trot', model_type=%d, activity_type=%d",
			record.activity_data.model_type, record.activity_data.activity_type);
		return -1;
	}

	// the 2nd is a 'repetition' and the 3rd is another 'trot'.  the 'walk'
	// inferences come after that.
	// TODO: the inference data is different depending on previous state - i.e.,
	// 'initiate()' doesn't seem to reset state.  We need to discuss this with PTC

	// the 4th record should be a 'walk' activity
	storage_read_activity_record((char *)filename, 3, &record);
	if ((record.activity_data.model_type != Activity) ||
	    (record.activity_data.activity_type != walk)) {
		LOG_ERR("wrong inference data: expected 'walk', model_type=%d, activity_type=%d",
			record.activity_data.model_type, record.activity_data.activity_type);
		return -1;
	}
	storage_delete_activity_file((char *)filename);
	LOG_INF("Test passed!");

	return 0;
}

SHELL_CMD_REGISTER(ml_test, NULL, "test ML library", ml_test_shell);
