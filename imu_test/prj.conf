## CMakeLists.txt
```
# Copyright (c) 2023 Culvert Engineering Inc
# SPDX-License-Identifier: Apache-2.0

cmake_minimum_required(VERSION 3.20.0)

set(DTC_OVERLAY_FILE ../boards/${BOARD}.overlay)

get_filename_component(APPLICATION_PROJECT_DIR
    ${CMAKE_CURRENT_LIST_DIR}/..
    ABSOLUTE
)


list(APPEND BOARD_ROOT ${APPLICATION_PROJECT_DIR})
list(APPEND DTS_ROOT ${APPLICATION_PROJECT_DIR})
message(ADDING BOARD_ROOT="${BOARD_ROOT}")
message(ADDING DTS_ROOT="${DTS_ROOT}")



find_package(Zephyr REQUIRED HINTS $ENV{ZEPHYR_BASE})

project(imu_test VERSION 0.0.2)
target_sources(app PRIVATE src/main.c src/board.c src/shell.c)
add_subdirectory(src/imu)
add_subdirectory(src/storage)
add_subdirectory(src/ble)

add_definitions(-DAPP_VERSION_MAJOR=${PROJECT_VERSION_MAJOR})
add_definitions(-DAPP_VERSION_MINOR=${PROJECT_VERSION_MINOR})
add_definitions(-DAPP_VERSION_PATCH=${PROJECT_VERSION_PATCH})
```

## prj.conf
```kconfig
# General
CONFIG_I2C=y
CONFIG_SHELL=y
CONFIG_LOG=y
CONFIG_MAIN_STACK_SIZE=8192

# IMU
CONFIG_SENSOR=y
CONFIG_LSM6DSV16X=y
CONFIG_LSM6DSV16X_TRIGGER_GLOBAL_THREAD=n
CONFIG_LSM6DSV16X_TRIGGER_OWN_THREAD=y
CONFIG_LSM6DSV16X_THREAD_STACK_SIZE=4096

# Flash
CONFIG_FLASH=y
CONFIG_FLASH_PAGE_LAYOUT=y
CONFIG_FLASH_SHELL_TEST_COMMANDS=y
CONFIG_FLASH_MAP=y
CONFIG_FLASH_MAP_SHELL=y
CONFIG_FLASH_MAP_LABELS=y
CONFIG_NORDIC_QSPI_NOR=y
CONFIG_MPU_ALLOW_FLASH_WRITE=y

# Filesystem
CONFIG_FILE_SYSTEM=y
CONFIG_FILE_SYSTEM_LITTLEFS=y
CONFIG_FILE_SYSTEM_SHELL=y
CONFIG_FILE_SYSTEM_SHELL_TEST_COMMANDS=y
# use all 4MB of external flash
CONFIG_PM_PARTITION_SIZE_LITTLEFS=0x400000
CONFIG_PM_PARTITION_REGION_LITTLEFS_EXTERNAL=y

# BLE
CONFIG_BT=y
CONFIG_BT_PERIPHERAL=y
CONFIG_BT_BAS=y
CONFIG_BT_DEVICE_NAME_DYNAMIC=y

# MCUBoot
CONFIG_BOOTLOADER_MCUBOOT=y
CONFIG_MCUBOOT_GENERATE_UNSIGNED_IMAGE=y
CONFIG_MCUBOOT_GENERATE_CONFIRMED_IMAGE=y

# NOTE: we want to save as much as possible of the 4MB external flash for storing data.
# If we want to sacrafice some external flash memory for code-space, change this to 'y',
# and add support in MCUboot for secondary image in external flash, see:
# https://github.com/CuvertEngineering/purina-d1/pull/7/files
CONFIG_PM_EXTERNAL_FLASH_MCUBOOT_SECONDARY=n

# DFU - this enables all required SMP handlers and SMP BT reassembly feature
CONFIG_NCS_SAMPLE_MCUMGR_BT_OTA_DFU=y

# Network core upgrades
CONFIG_NRF53_UPGRADE_NETWORK_CORE=y
CONFIG_DFU_MULTI_IMAGE_PACKAGE_BUILD=y
CONFIG_DFU_MULTI_IMAGE_PACKAGE_NET=y
```

## src/main.c
```c
/*
 * Copyright (c) 2023 Culvert Engineering Inc
 *
 * SPDX-License-Identifier: Apache-2.0
 */

#include <zephyr/kernel.h>
#include <zephyr/logging/log.h>

#include <zephyr/device.h>
#include <zephyr/drivers/gpio.h>
#include <zephyr/dfu/mcuboot.h>

#include "ble.h"
#include "imu.h"
#include "storage.h"

LOG_MODULE_REGISTER(main, LOG_LEVEL_DBG);

int main(void)
{
	LOG_INF("Staring imu_test Version %d.%d.%d \r\nBoard: %s", APP_VERSION_MAJOR,
			APP_VERSION_MINOR, APP_VERSION_PATCH, CONFIG_BOARD);

	imu_init();
	storage_init();
	ble_init();

	/*
	   mark the currently running firmware image as OK,
	   which will install it permanently after an OTA
	 */
	boot_write_img_confirmed();

	while (1)
	{
		k_sleep(K_MSEC(1000));
	}
	return 0;
}
```

## src/board.c
```c
/*
 * Copyright (c) 2022 Kenzen Inc.
 *
 * SPDX-License-Identifier: Unlicensed
 */

#include <zephyr/kernel.h>
#include <zephyr/init.h>
#include <zephyr/device.h>
#include <zephyr/drivers/gpio.h>

#define ZEPHYR_USER_NODE DT_PATH(zephyr_user)

#define ACCEL_ON (7)

static int board_d1_init(void)
{
	static const struct device *en_imu = DEVICE_DT_GET(DT_NODELABEL(gpio0));
	if (en_imu == NULL)
	{
		printk("Error: failed to find gpio0\n");
		return 0;
	}
	else
	{
		int ret = gpio_pin_configure(en_imu, ACCEL_ON, GPIO_OUTPUT_ACTIVE);
		if (ret != 0)
		{
			printk("Error: failed to configure ACCEL_ON\n");
		}
		else
		{
			printk("powered on the IMU\n");
		}
	}

	return 0;
}

SYS_INIT(board_d1_init, PRE_KERNEL_1,
		 CONFIG_KERNEL_INIT_PRIORITY_DEFAULT);
```

## src/shell.c
```c
#include <zephyr/logging/log_ctrl.h>
#include <zephyr/logging/log.h>
#include <zephyr/shell/shell.h>
#include <stdlib.h>
#include <stdio.h>

#include "imu.h"
#include "storage.h"

LOG_MODULE_REGISTER(shell, LOG_LEVEL_DBG);

static int version(const struct shell *sh, size_t argc, char **argv)
{
    shell_fprintf(sh, SHELL_NORMAL, "App version %d.%d.%d\r\n", APP_VERSION_MAJOR,
                  APP_VERSION_MINOR, APP_VERSION_PATCH);
    return 0;
}

// callback for write_samples, called on every imu trigger
int write_samples_cb(imu_sample_t data)
{
    int ret = storage_write_imu_sample(data);
    if (ret)
    {
        LOG_ERR("failed to write imu sample: ret=%d", ret);
        return -1;
    }

    return 0;
}

static int write_samples(const struct shell *sh, size_t argc, char **argv)
{
    char *filename = argv[1];
    uint16_t freq = strtoul(argv[2], NULL, 10);
    uint16_t seconds = strtoul(argv[3], NULL, 10);

    if (argc < 4 || seconds == 0)
    {
        shell_fprintf(sh, SHELL_NORMAL, "usage: write_samples <filename> <freq> <seconds>\r\n");
        return -1;
    }

    int ret = storage_open_file(filename);
    if (ret)
    {
        LOG_ERR("failed to open file %s", filename);
        return -1;
    }

    LOG_INF("writing IMU samples at %d Hz for %d seconds to file: %s...", freq, seconds, filename);
    LOG_PANIC(); // flush

    ret = imu_enable(freq, write_samples_cb);
    if (ret)
    {
        LOG_ERR("failed to enable IMU");
        storage_close_file(filename);
        return -1;
    }

    k_sleep(K_SECONDS(seconds));
    imu_enable(IMU_ODR_0_HZ, NULL);

    storage_close_file(filename);

    int count = imu_get_trigger_count();

    LOG_INF("complete, wrote %d samples, avg=%.2f/s", count, (float)count / (float)seconds);
    return 0;
}

// callback for print_samples, called on every imu trigger
int print_samples_cb(imu_sample_t data)
{
    LOG_INF("%08llu,%f,%f,%f,%f,%f,%f", data.timestamp,
            data.ax, data.ay, data.az,
            data.gx, data.gy, data.gz);

    return 0;
}

static int print_samples(const struct shell *sh, size_t argc, char **argv)
{
    uint16_t freq = strtoul(argv[1], NULL, 10);
    uint16_t seconds = strtoul(argv[2], NULL, 10);

    if (argc < 3 || seconds == 0)
    {
        shell_fprintf(sh, SHELL_NORMAL, "usage: print_samples <freq> <seconds>\r\n");
        return -1;
    }

    LOG_INF("printing IMU samples at %d Hz for %d seconds...", freq, seconds);
    LOG_PANIC(); // flush

    int ret = imu_enable(freq, print_samples_cb);
    if (ret)
    {
        LOG_ERR("failed to enable IMU");
        return -1;
    }

    k_sleep(K_SECONDS(seconds));
    imu_enable(IMU_ODR_0_HZ, NULL);

    int count = imu_get_trigger_count();

    LOG_INF("complete, printed %d samples, avg=%.2f/s", count, (float)count / (float)seconds);
    return 0;
}

SHELL_CMD_REGISTER(version, NULL, "app version", version);
SHELL_CMD_REGISTER(write_samples, NULL, "usage: write_samples <filename> <freq> <seconds>", write_samples);
SHELL_CMD_REGISTER(print_samples, NULL, "usage: print_samples <freq> <seconds>", print_samples);
```
