## lib/drivers/Kconfig
```kconfig
# Copyright (c) 2024 Culvert Engineering LLC

# source all subdirectories
rsource "sensor/Kconfig"
```

## lib/drivers/sensor/Kconfig
```kconfig
# Copyright (c) 2024 Culvert Engineering LLC

# source all subdirectories
rsource "lsm6dsv16x-d1/Kconfig"
```

## lib/drivers/sensor/lsm6dsv16x-d1/Kconfig
```kconfig
# Enhanced ST Microelectronics LSM6DSV16X_D1 6-axis IMU sensor driver

# Copyright (c) 2023 STMicroelectronics
# Copyright (c) 2024 Culvert Engineering
# SPDX-License-Identifier: Apache-2.0

menuconfig LSM6DSV16X_D1
	bool "Enhanced LSM6DSV16X I2C/SPI accelerometer and gyroscope Chip"
	default y
	depends on DT_HAS_ST_LSM6DSV16X_D1_ENABLED
	select I2C if $(dt_compat_on_bus,$(DT_COMPAT_ST_LSM6DSV16X_D1),i2c)
	select SPI if $(dt_compat_on_bus,$(DT_COMPAT_ST_LSM6DSV16X_D1),spi)
	select HAS_STMEMSC
	select USE_STDC_LSM6DSV16X
	help
	  Enable driver for LSM6DSV16X_D1 accelerometer and gyroscope
	  sensor.

if LSM6DSV16X_D1

choice LSM6DSV16X_D1_TRIGGER_MODE
	prompt "Trigger mode"
	help
	  Specify the type of triggering to be used by the driver.

config LSM6DSV16X_D1_TRIGGER_NONE
	bool "No trigger"

config LSM6DSV16X_D1_TRIGGER_GLOBAL_THREAD
	bool "Use global thread"
	depends on GPIO
	select LSM6DSV16X_D1_TRIGGER

config LSM6DSV16X_D1_TRIGGER_OWN_THREAD
	bool "Use own thread"
	depends on GPIO
	select LSM6DSV16X_D1_TRIGGER

endchoice

config LSM6DSV16X_D1_TRIGGER
	bool

if LSM6DSV16X_D1_TRIGGER

config LSM6DSV16X_D1_THREAD_PRIORITY
	int "Thread priority"
	depends on LSM6DSV16X_D1_TRIGGER_OWN_THREAD
	default 10
	help
	  Priority of thread used by the driver to handle interrupts.

config LSM6DSV16X_D1_THREAD_STACK_SIZE
	int "Thread stack size"
	depends on LSM6DSV16X_D1_TRIGGER_OWN_THREAD
	default 1024
	help
	  Stack size of thread used by the driver to handle interrupts.

endif # LSM6DSV16X_D1_TRIGGER

config LSM6DSV16X_D1_ENABLE_TEMP
	bool "Temperature"
	help
	  Enable/disable temperature

config LSM6DSV16X_D1_ENABLE_MOTION
	bool "Motion detector"
	help
	  Enable/Disable significant motion detection

if LSM6DSV16X_D1_ENABLE_MOTION
config LSM6DSV16X_D1_SLEEP_THRESHOLD
    int "Threshold for IMU inactivity"
    range 0 7
    default 3
    help
        Set the threshold for IMU inactivity:
        WU_INACT_THS_W_[2:0]
        0 = 7.8125 mg
        1 = 15.625 mg
        2 = 31.25 mg
        3 = 62.5 mg
        4 = 125 mg
        5-7 = 250 mg

config LSM6DSV16X_D1_SLEEP_DURATION
    int "Duration of inactivity to trigger sleep"
    range 0 65535
    default 2
    help
        set the time to go into sleep mode.
        0 = 1.07 seconds
        >1 = (512*duration)/15 or duration * 34.13 seconds
endif # LSM6DSV16X_D1_ENABLE_MOTION

config LSM6DSV16X_D1_SENSORHUB
	bool "I2C sensorhub feature"
	help
	  Enable/disable internal sensorhub. You can enable
	  a maximum of two external sensors (if more than two are enabled
	  the system would enumerate only the first two found)

if LSM6DSV16X_D1_SENSORHUB

config LSM6DSV16X_D1_EXT_LIS2MDL
	bool "LIS2MDL as external sensor"
	default y

config LSM6DSV16X_D1_EXT_LPS22HH
	bool "LPS22HH as external sensor"

config LSM6DSV16X_D1_EXT_HTS221
	bool "HTS221 as external sensor"

config LSM6DSV16X_D1_EXT_LPS22HB
	bool "LPS22HB as external sensor"

config LSM6DSV16X_D1_EXT_LPS22DF
	bool "LPS22DF as external sensor"
	default y

endif # LSM6DSV16X_D1_SENSORHUB

endif # LSM6DSV16X_D1
```

## lte_test_nestle/src/modules/spi_5340/Kconfig.spi_5340
```kconfig
#
# Copyright (c) 2023 Nordic Semiconductor
#
# SPDX-License-Identifier: LicenseRef-Nordic-5-Clause
#

menu "Spi_5340"

config MQTT_SAMPLE_5340_SPI_THREAD_STACK_SIZE
	int "Thread stack size"
	default 1024

config MQTT_SAMPLE_5340_SPI_MESSAGE_QUEUE_SIZE
	int "Message queue size"
	default 5
	help
	  ZBus subscriber message queue size.

module = MQTT_SAMPLE_5340_SPI
module-str = spi_5340
source "subsys/logging/Kconfig.template.log_config"

endmenu # spi_5340
```

## purina_d1_lte/src/gps/Kconfig
```kconfig
#
# Copyright (c) 2020 Nordic Semiconductor ASA
#
# SPDX-License-Identifier: LicenseRef-Nordic-5-Clause
#

menu "GNSS"

choice
	default PURINA_D1_LTE_MODE_CONTINUOUS
	prompt "Select GNSS operation mode"

config PURINA_D1_LTE_MODE_CONTINUOUS
	bool "Continuous tracking"

config PURINA_D1_LTE_MODE_PERIODIC
	bool "Periodic fixes"

config PURINA_D1_LTE_MODE_TTFF_TEST
	bool "Time-to-first-fix (TTFF) test mode"
	select PURINA_D1_LTE_NMEA_ONLY

endchoice

if PURINA_D1_LTE_MODE_PERIODIC

config PURINA_D1_LTE_PERIODIC_INTERVAL
	int "Fix interval for periodic fixes"
	range 10 65535
	default 120
	help
	  Fix interval (in seconds) for periodic fixes.

config PURINA_D1_LTE_PERIODIC_TIMEOUT
	int "Fix timeout for periodic fixes"
	range 0 65535
	default 120
	help
	  Fix timeout (in seconds) for periodic fixes.
	  If set to zero, GNSS is allowed to run indefinitely until a valid PVT estimate is produced.

endif # PURINA_D1_LTE_MODE_PERIODIC

if PURINA_D1_LTE_MODE_TTFF_TEST

config PURINA_D1_LTE_MODE_TTFF_TEST_COLD_START
	bool "Delete GNSS data before each start (cold start)"
	help
	  When enabled, deletes all stored data from GNSS to force a cold start every time GNSS is started.

config PURINA_D1_LTE_MODE_TTFF_TEST_INTERVAL
	int "Time to wait between TTFF tests in seconds"
	range 1 604800
	default 120

endif # PURINA_D1_LTE_MODE_TTFF_TEST

config PURINA_D1_LTE_NMEA_ONLY
	bool "Output only NMEA strings"
	help
	  Outputs only NMEA strings from the GNSS.

endmenu

choice
	default PURINA_D1_LTE_ASSISTANCE_NONE
	prompt "Select whether GNSS assistance is used or not"

config PURINA_D1_LTE_ASSISTANCE_NONE
	bool "Assistance not used"

config PURINA_D1_LTE_ASSISTANCE_NRF_CLOUD
	bool "Use nRF Cloud A-GNSS"
	select NRF_CLOUD_REST
	imply NRF_CLOUD_AGNSS
	select MODEM_JWT
	select MODEM_INFO
	select DATE_TIME

config PURINA_D1_LTE_ASSISTANCE_SUPL
	bool "Use SUPL assistance"
	select SUPL_CLIENT_LIB

config PURINA_D1_LTE_ASSISTANCE_MINIMAL
	bool "Use factory almanac, LTE network time and MCC based location"
	select PURINA_D1_LTE_LTE_ON_DEMAND
	select SETTINGS
	select FCB
	select FLASH
	select FLASH_MAP

endchoice

if !PURINA_D1_LTE_ASSISTANCE_NONE

config PURINA_D1_LTE_LTE_ON_DEMAND
	bool "LTE is activated only when needed to fetch A-GNSS data"
	depends on !NRF_CLOUD_PGPS
	help
	  Activates LTE only when it is needed to fetch A-GNSS data. This is not supported when
	  P-GPS is enabled.

endif # !PURINA_D1_LTE_ASSISTANCE_NONE

if PURINA_D1_LTE_ASSISTANCE_SUPL

config PURINA_D1_LTE_SUPL_HOSTNAME
	string "SUPL server hostname"
	help
	  SUPL server hostname.

config PURINA_D1_LTE_SUPL_PORT
	int "SUPL server port number"
	range 0 65535
	default 7276
	help
	  SUPL server port number.

endif # PURINA_D1_LTE_ASSISTANCE_SUPL

if PURINA_D1_LTE_MODE_CONTINUOUS

choice
	default PURINA_D1_LTE_POWER_SAVING_DISABLED
	prompt "Select GNSS power saving mode (duty-cycling)"

config PURINA_D1_LTE_POWER_SAVING_DISABLED
	bool "No power saving"

config PURINA_D1_LTE_POWER_SAVING_MODERATE
	bool "Power saving without significant performance degradation"

config PURINA_D1_LTE_POWER_SAVING_HIGH
	bool "Power saving with acceptable performance degradation"

endchoice

endif # PURINA_D1_LTE_MODE_CONTINUOUS

config PURINA_D1_LTE_REFERENCE_LATITUDE
	string "Reference position latitude in decimal degrees"
	help
	  When set, the sample calculates the distance from the reference position for each fix.
	  Given in decimal degrees (DD), for example "61.500000".

config PURINA_D1_LTE_REFERENCE_LONGITUDE
	string "Reference position longitude in decimal degrees"
	help
	  When set, the sample calculates the distance from the reference position for each fix.
	  Given in decimal degrees (DD), for example "23.800000".

config PURINA_D1_LTE_LOW_ACCURACY
	bool "Allow low accuracy fixes"
	help
	  Allows fixes with lower accuracy.

if PURINA_D1_LTE_ASSISTANCE_MINIMAL && PURINA_D1_LTE_LOW_ACCURACY

config PURINA_D1_LTE_ASSISTANCE_REFERENCE_ALT
	int "Reference altitude for 3-sat first fix in meters"
	range -32767 32767
	default -32767
	help
	  Reference altitude for 3-sat first fix in meters above the reference ellipsoid surface.
	  The default value -32767 implies that reference altitude is not injected.

endif # PURINA_D1_LTE_ASSISTANCE_MINIMAL && PURINA_D1_LTE_LOW_ACCURACY
```

## west.yml
```yaml
# This workflow uses badger-zephyr as the manifest repository.
manifest:
  remotes:
    - name: ncs
      url-base: https://github.com/nrfconnect
    - name: culvert
      url-base: git@github.com:CuvertEngineering
      
  projects:
      # Nordic Connect SDK, including nrfxlib, Zephyr, MCUBoot, and mbedtls
    - name: sdk-nrf
      remote: ncs
      revision: v2.5.0
      repo-path: sdk-nrf
      path: nrf
      import: true

    - name: purina-d1-tools
      remote: culvert
      revision: main
      repo-path: purina-d1-tools
      path: purina-d1-tools
```
