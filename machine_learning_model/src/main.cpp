#include <zephyr/kernel.h>
#include <nrfx_clock.h>
#include "baseLib.hpp"
#include <iostream>
#include <string.h>

const float test_sample[] = {
+8.85464, +1.85204, -3.91705, -0.00122, +0.01038, -0.00397,
+8.87378, +1.81974, -3.90389, -0.00122, +0.01038, -0.00397,
+8.84746, +1.80538, -3.92901, -0.00122, +0.01038, -0.00397,
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+8.82712, +1.81735, -3.88834, -0.00122, +0.01038, -0.00397,
};

void handleInferResult(InferResult result)
{

printk("\n%d  %f  %llu   %llu  %f  %f  %f  %f", (int)result.pred_class
                                            ,(float)result.pred_reps
                                            ,(uint64_t)result.start_timestamp
                                            ,(uint64_t)result.end_timestamp
                                            ,(float)result.accel_mag_mean_val
                                            ,(float)result.gyro_mag_mean_val
                                            ,(float)result.accel_mag_sd_val
                                            ,(float)result.gyro_mag_sd_val
											);
}

uint64_t ei_read_timer_ms() {
    return k_uptime_get();
}

uint64_t ei_read_timer_us() {
    return k_uptime_get() * 1000;
}




int main()
{
    uint64_t timestamp = 0;
    struct IMUData imu_sample;

    printk("\nLibrary Version %s", getVersion());

    if( false == initiate(handleInferResult) )
    {
        printk("\nLib not correctly initialized");
    }
    k_msleep(500);
    while (1)
    {
        if( false == resetActivityWindowCounter() )
        {
            printk("\nReset Counter not performed");
        }
        for (int n = 0; n < 4; n++)
        {
            printk("\nSet %d:\n", n+1);
            for (int i = 0; i < 700*6;)
            {
                memcpy(&imu_sample.imuValues, &test_sample[i], 6 * 4);
                imu_sample.timestamp = timestamp++;
                if( false == processIMUData(imu_sample) )
                {
                    printk("\nIMU Data Not Processed");
                }
                k_msleep(67);
                i = i + 6;
            }
        }
        printk("\nrestart\n");
    }
}