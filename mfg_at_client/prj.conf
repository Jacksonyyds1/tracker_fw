## CMakeLists.txt
```
# Copyright (c) 2023 Nordic Semiconductor ASA
# SPDX-License-Identifier: Apache-2.0

cmake_minimum_required(VERSION 3.20.0)

set(DTC_OVERLAY_FILE ./nrf9160dk_nrf9160_ns_mfg.overlay)

get_filename_component(APPLICATION_PROJECT_DIR
    ${CMAKE_CURRENT_LIST_DIR}/..
    ABSOLUTE
)

find_package(Zephyr REQUIRED HINTS $ENV{ZEPHYR_BASE})

list(APPEND BOARD_ROOT ${APPLICATION_PROJECT_DIR})
list(APPEND DTS_ROOT ${APPLICATION_PROJECT_DIR})
message(ADDING BOARD_ROOT="${BOARD_ROOT}")
message(ADDING DTS_ROOT="${DTS_ROOT}")



find_package(Zephyr REQUIRED HINTS $ENV{ZEPHYR_BASE})

project(mfg_at_client VERSION 0.0.1)
target_sources(app PRIVATE src/main.c)
add_subdirectory(src/5340Interface)

add_definitions(-DAPP_VERSION_MAJOR=${PROJECT_VERSION_MAJOR})
add_definitions(-DAPP_VERSION_MINOR=${PROJECT_VERSION_MINOR})
add_definitions(-DAPP_VERSION_PATCH=${PROJECT_VERSION_PATCH})
```

## Kconfig
```
# Copyright (c) 2021 Nordic Semiconductor ASA
# SPDX-License-Identifier: Apache-2.0
#
# This file is the application Kconfig entry point. All application Kconfig
# options can be defined here or included via other application Kconfig files.
# You can browse these options using the west targets menuconfig (terminal) or
# guiconfig (GUI).

menu "Zephyr"
source "Kconfig.zephyr"
endmenu

module = modem
module-str = modem
source "subsys/logging/Kconfig.template.log_config"

config USE_UART_TO_NRF5340
    bool "use UART to NRF5340"
    default false
    help 
        Use UART to NRF5340
```

## prj.conf
```kconfig
CONFIG_ASSERT=y
CONFIG_GPIO=y

# Network
CONFIG_NETWORKING=y
CONFIG_NET_NATIVE=n
CONFIG_NET_SOCKETS=y
CONFIG_NET_SOCKETS_OFFLOAD=y
CONFIG_NET_SOCKETS_POSIX_NAMES=y

# Modem library
CONFIG_NRF_MODEM_LIB=y

# AT host library
CONFIG_AT_HOST_LIBRARY=y
CONFIG_UART_INTERRUPT_DRIVEN=y

# Stacks and heaps
CONFIG_MAIN_STACK_SIZE=3072
CONFIG_HEAP_MEM_POOL_SIZE=16384

#CONFIG_BOOTLOADER_MCUBOOT=y

CONFIG_SPI=y
CONFIG_SPI_ASYNC=y
CONFIG_SPI_SLAVE=y

CONFIG_USE_UART_TO_NRF5340=y
```

## src/main.c
```c
/*
 * Copyright (c) 2018 Nordic Semiconductor ASA
 *
 * SPDX-License-Identifier: LicenseRef-Nordic-5-Clause
 */

#include <zephyr/kernel.h>
#include <stdio.h>
#include <string.h>
#include <modem/nrf_modem_lib.h>
#include <zephyr/drivers/uart.h>
#include "5340_interface.h"


// #include <zephyr/drivers/clock_control.h>
// #include <zephyr/drivers/clock_control/nrf_clock_control.h>




int init_devices() {
	int err;

	err = nrf_modem_lib_init();
	if (err) {
		printk("Modem library initialization failed, error: %d\n", err);
		return 0;
	}
	printk("Modem Ready\n");

	init_5340_interface();


	return 0;
}

int main(void)
{
	//int err;

	init_devices();

	return 0;
}
```
